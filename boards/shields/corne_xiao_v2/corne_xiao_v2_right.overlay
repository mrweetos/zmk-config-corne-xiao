#include "corne_xiao_v2.dtsi"

&default_transform {
    col-offset = <6>;
};

&five_column_transform {
    col-offset = <6>;
};

&kscan0 {
    col-gpios
        = <&xiao_d 6 GPIO_ACTIVE_HIGH>
        , <&xiao_d 7 GPIO_ACTIVE_HIGH> 
        , <&xiao_d 8 GPIO_ACTIVE_HIGH>
        , <&xiao_d 10 GPIO_ACTIVE_HIGH>
        , <&xiao_d 3 GPIO_ACTIVE_HIGH>
        , <&xiao_d 4 GPIO_ACTIVE_HIGH>;  // This is D4, correct for the friction07 PCB
        ;
};

&right_encoder {
    status = "okay";
};
