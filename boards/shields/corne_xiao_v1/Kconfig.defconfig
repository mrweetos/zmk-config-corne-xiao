## boards/shields/corne_xiao_v1/Kconfig.defconfig
```kconfig
if SHIELD_CORNE_XIAO_V1_LEFT

config ZMK_KEYBOARD_NAME
    default "Corne"

config ZMK_SPLIT_ROLE_CENTRAL
    default y

endif

if SHIELD_CORNE_XIAO_V1_LEFT || SHIELD_CORNE_XIAO_V1_RIGHT

config ZMK_SPLIT
    default y

endif
```

## boards/shields/corne_xiao_v1/Kconfig.shield
```kconfig
config SHIELD_CORNE_XIAO_V1_LEFT
    def_bool $(shields_list_contains,corne_xiao_v1_left)

config SHIELD_CORNE_XIAO_V1_RIGHT
    def_bool $(shields_list_contains,corne_xiao_v1_right)
```

## boards/shields/corne_xiao_v2/Kconfig.shield
```kconfig
config SHIELD_CORNE_XIAO_V2_LEFT
    def_bool $(shields_list_contains,corne_xiao_v2_left)

config SHIELD_CORNE_XIAO_V2_RIGHT
    def_bool $(shields_list_contains,corne_xiao_v2_right)
```

## config/west.yml
```yaml
manifest:
  remotes:
    - name: zmkfirmware
      url-base: https://github.com/zmkfirmware
    - name: caksoylar
      url-base: https://github.com/caksoylar
    - name: mctechnology17
      url-base: https://github.com/mctechnology17
  projects:
    - name: zmk
      remote: zmkfirmware
      revision: main
      import: app/west.yml
    - name: zmk-rgbled-widget
      remote: caksoylar
      revision: main

  self:
    path: config
```
